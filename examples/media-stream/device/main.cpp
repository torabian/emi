// Host-side stand-in for the ESP32 firmware: same generated C++ calls, but the
// "microphone" is a 440 Hz sine and the "camera" is a tiny embedded JPEG.
// On the real device only the two marked capture functions change - see
// esp32/main.cpp.example.
//
//   make device && ./device/media-device [host] [port] [seconds]
#include "StreamMediaAction.hpp"
#include "EmiByteStreamPosix.hpp"
#include "EmiMediaFrame.hpp"

#include <chrono>
#include <cmath>
#include <cstdio>
#include <cstdlib>
#include <thread>

static const uint8_t kFakeJpeg[] = {
    0xFF, 0xD8, 0xFF, 0xE0, 0x00, 0x10, 0x4A, 0x46, 0x49, 0x46, 0x00, 0x01, 0x01, 0x00, 0x00, 0x01,
    0x00, 0x01, 0x00, 0x00, 0xFF, 0xDB, 0x00, 0x43, 0x00, 0x10, 0x0B, 0x0C, 0x0E, 0x0C, 0x0A, 0x10,
    0x0E, 0x0D, 0x0E, 0x12, 0x11, 0x10, 0x13, 0x18, 0x28, 0x1A, 0x18, 0x16, 0x16, 0x18, 0x31, 0x23,
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    0xA2, 0x8A, 0x2B, 0x88, 0xFA, 0x63, 0xFF, 0xD9,
};

constexpr int kSampleRate = 16000;
constexpr int kFrameMs = 20;                              // one audio packet every 20 ms
constexpr int kSamplesPerFrame = kSampleRate * kFrameMs / 1000;
constexpr int kVideoEveryMs = 200;                        // 5 fps

// ---- the only parts that differ on the ESP32 ------------------------------------
static size_t ReadMicrophone(int16_t* out, size_t samples, uint32_t nowMs) {
    static double phase = 0;
    (void) nowMs;
    for (size_t i = 0; i < samples; i++) {
        out[i] = (int16_t) (8000 * std::sin(phase));
        phase += 2 * M_PI * 440.0 / kSampleRate;
    }
    return samples;               // ESP32: i2s_channel_read(rx_handle, out, ...)
}

static const uint8_t* GrabCameraFrame(size_t& length) {
    length = sizeof(kFakeJpeg);   // ESP32: fb = esp_camera_fb_get(); length = fb->len; return fb->buf;
    return kFakeJpeg;
}
// ----------------------------------------------------------------------------------

int main(int argc, char** argv) {
    const char* host = argc > 1 ? argv[1] : "127.0.0.1";
    const char* port = argc > 2 ? argv[2] : "8080";
    const int seconds = argc > 3 ? std::atoi(argv[3]) : 3;

    emi::EmiClientConfig& config = emi::EmiClientConfig::Default();
    config.baseUrl = std::string("http://") + host + ":" + port;

    // Typed path + query parameters, straight from media.emi.yml.
    StreamMediaActionPathParameters path;
    path.deviceId = "esp32-kitchen";
    StreamMediaActionQueryParams query;
    query.sampleRate = kSampleRate;
    query.channels = 1;
    query.audioCodec = "pcm16";
    query.videoCodec = "mjpeg";

    emi::EmiByteStreamPosix stream;   // ESP-IDF: the very same class (lwIP BSD sockets)
    auto socket = StreamMediaActionSocket::Create(stream, path, query, config);
    socket->onError = [](const std::string& e) { std::fprintf(stderr, "error: %s\n", e.c_str()); };
    if (!socket->IsOpen()) return 1;

    emi::EmiMediaSender sender(*socket);
    int16_t pcm[kSamplesPerFrame];
    auto start = std::chrono::steady_clock::now();
    auto next = start;
    uint32_t lastVideoMs = 0;
    int audioFrames = 0, videoFrames = 0;

    while (socket->IsOpen()) {
        uint32_t nowMs = (uint32_t) std::chrono::duration_cast<std::chrono::milliseconds>(
            std::chrono::steady_clock::now() - start).count();
        if (nowMs >= (uint32_t) seconds * 1000) break;

        size_t n = ReadMicrophone(pcm, kSamplesPerFrame, nowMs);
        // PCM16 is little endian on the wire, which is also the ESP32's native order.
        if (!sender.SendAudio((const uint8_t*) pcm, n * sizeof(int16_t), nowMs)) break;
        audioFrames++;

        if (nowMs - lastVideoMs >= kVideoEveryMs) {
            size_t len = 0;
            const uint8_t* jpg = GrabCameraFrame(len);
            if (!sender.SendVideo(jpg, len, nowMs)) break;
            lastVideoMs = nowMs;
            videoFrames++;
        }

        next += std::chrono::milliseconds(kFrameMs);
        std::this_thread::sleep_until(next);
    }

    socket->Close();
    std::printf("sent %d audio frames, %d video frames\n", audioFrames, videoFrames);
    return 0;
}
